/*
 * Copyright (c) 2026 Espressif Systems (Shanghai) Co., Ltd.
 *
 * SPDX-License-Identifier: Apache-2.0
 */

/* The USB 2.0 Type-A port is wired to the OTG HS controller; use it as host. */
zephyr_uhc0: &usb_otg {
	status = "okay";
};
