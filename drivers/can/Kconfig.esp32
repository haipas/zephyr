## drivers/can/Kconfig.esp32
```kconfig
# Espressif ESP32 TWAI configuration options

# Copyright (c) 2022 Henrik Brix Andersen <henrik@brixandersen.dk>
# Copyright (c) 2026 Espressif Systems (Shanghai) Co., Ltd.
# SPDX-License-Identifier: Apache-2.0

config CAN_ESP32_TWAI
	bool "Espressif TWAI CAN driver"
	default y
	depends on DT_HAS_ESPRESSIF_ESP32_TWAI_ENABLED
	select CAN_SJA1000
	select PINCTRL
	help
	  This enables support for the Espressif Two-Wire Automotive Interface
	  (TWAI) CAN driver.

config CAN_ESP32_TWAI_RX_IRAM
	bool "TWAI receive that keeps running while flash is written (3d local)"
	depends on CAN_ESP32_TWAI && SMP && SCHED_CPU_MASK && MP_MAX_NUM_CPUS > 1
	depends on !TICKET_SPINLOCKS && !SPIN_VALIDATE
	help
	  3d-fw#1277. A flash operation locks the interrupts of its core and
	  parks the other core with its non-IRAM interrupts masked, so the
	  TWAI interrupt (flash code) was blind for a whole erase, the 64-byte
	  RX FIFO overran and the frames behind the overrun were read with
	  wrong data. With this option the TWAI interrupt is allocated as an
	  IRAM interrupt at CAN_ESP32_TWAI_RX_IRAM_LEVEL on
	  CAN_ESP32_TWAI_RX_IRAM_CPU (from a thread pinned there): its handler
	  copies every frame into a ring in internal RAM and releases overrun
	  frames (TWAI_MISS_ST) unread. Decoding, the RX filter callbacks and
	  the transmit/error handling run from the same handler when that core
	  is not parked, else from the thread. Every flash operation must run
	  on the other core.

if CAN_ESP32_TWAI_RX_IRAM

config CAN_ESP32_TWAI_RX_IRAM_CPU
	int "Core the TWAI interrupt is allocated on"
	default 1
	range 0 1

config CAN_ESP32_TWAI_RX_IRAM_LEVEL
	int "Interrupt level of the TWAI interrupt"
	default 2
	range 2 3
	help
	  Above the level-1 stall IPI that parks the core during the other
	  core's flash operation. 2 lets a level-3 interrupt (the 1 ms cycle)
	  preempt it.

config CAN_ESP32_TWAI_RX_RING_FRAMES
	int "Frames the internal receive ring holds (power of two)"
	default 128
	help
	  13 bytes each. Must cover the longest cache-off window at the
	  highest frame rate: 128 frames are 128 ms at 1000 frames/s.

config CAN_ESP32_TWAI_RX_POLL_MS
	int "How often the thread hands on frames left over from a stall (ms)"
	default 5
	range 1 100

config CAN_ESP32_TWAI_RX_THREAD_STACK_SIZE
	int "Stack of the TWAI receive thread"
	default 2048
	help
	  The RX filter callbacks run on it for frames left over from a stall.

config CAN_ESP32_TWAI_RX_THREAD_PRIORITY
	int "Priority of the TWAI receive thread (preemptible)"
	default 8

endif # CAN_ESP32_TWAI_RX_IRAM

config CAN_ESP32_TWAIFD
	bool "Espressif TWAI-FD CAN driver"
	default y
	depends on DT_HAS_ESPRESSIF_ESP32_TWAIFD_ENABLED
	select PINCTRL
	help
	  Enables the Espressif TWAI-FD (CAN FD capable Two-Wire Automotive
	  Interface) controller driver.

if CAN_ESP32_TWAIFD

config CAN_ESP32_TWAIFD_MAX_FILTERS
	int "Maximum number of RX filters per TWAI-FD controller"
	default 16
	help
	  Maximum number of RX filters concurrently installable via
	  can_add_rx_filter() on a TWAI-FD controller instance. Filters
	  are matched in software; each slot is a few words of RAM, so
	  reduce this to conserve RAM if fewer filters are needed.

endif # CAN_ESP32_TWAIFD
```

## drivers/spi/Kconfig.esp32
```kconfig
# ESP32 SPI configuration

# Copyright (c) 2020 Espressif Systems (Shanghai) Co., Ltd.
# SPDX-License-Identifier: Apache-2.0

menuconfig ESP32_SPIM
	bool "ESP32 SPI controller driver"
	default y
	depends on DT_HAS_ESPRESSIF_ESP32_SPI_ENABLED
	help
	  Enables support for ESP32 SPI controller driver.

if ESP32_SPIM

config SPI_ESP32_INTERRUPT
	bool "ESP32 SPI interrupt mode"
	help
	  Enables interrupt support for ESP32 SPI driver.

config SPI_ESP32_DMA_BOUNCE_BYTES
	int "Static DMA bounce buffer per controller for buffers the DMA cannot reach"
	default 0
	range 0 4092
	help
	  A transfer buffer the GDMA cannot read or write -- external PSRAM,
	  an unaligned receive buffer -- is copied through a temporary buffer.
	  By default that buffer is allocated from the system heap for every
	  transfer (k_malloc of the transfer length), 16 allocations per 8 KiB
	  written to an SD card over SPI. Above 0, each controller instance
	  carries one static transmit and one static receive bounce buffer of
	  this size and uses them for every such transfer that fits; longer
	  transfers still take the heap path. 512 covers the block transfers of
	  the SD card driver (sdhc_spi) from a PSRAM page. Internal RAM: twice
	  this value per enabled controller.

config ESP32_SPI_TARGET
	bool "ESP32 SPI target mode"
	select SPI_PERIPHERAL
	select SPI_ESP32_INTERRUPT
	help
	  Enables target mode for the ESP32 SPI driver. Target
	  transactions are clocked by an external controller, so this
	  mode is interrupt driven and runs the SPI peripheral through
	  the dedicated target HAL.

if ESP32_SPI_TARGET

config SPI_ESP32_TARGET_MAX_BUFS
	int "Maximum scatter/gather buffers per target transaction"
	default 8
	help
	  Number of separate spi_buf segments that can be coalesced into a
	  single target transaction. A target frame is clocked by the
	  controller within one chip-select assertion, so the scattered
	  buffers are gathered into one contiguous FIFO transfer.

endif # ESP32_SPI_TARGET

endif # ESP32_SPIM
```

## dts/bindings/ethernet/phy/motorcomm,yt8521.yaml
```yaml
# Copyright 2025 NXP
# SPDX-License-Identifier: Apache-2.0

description: Motorcomm YT8521 Ethernet PHY

compatible: "motorcomm,yt8521"

include: ethernet-phy-common.yaml

properties:
  reset-gpios:
    type: phandle-array
    description: |
      GPIO connected to the PHY reset pin (active low, flag it
      GPIO_ACTIVE_LOW). When present, the driver holds the PHY in reset
      for 10 ms and waits 500 ms after releasing it before accessing the
      PHY registers.
  motorcomm,rx-delay-sel:
    type: int
    description: |
      RGMII RX_CLK delay train configuration, about 150ps per step.
      See RGMII_Config1 (EXT_0xA003) register for details
  motorcomm,tx-delay-sel:
    type: int
    description: |
      RGMII RX_CLK delay train configuration, about 150ps per step.
      See RGMII_Config1 (EXT_0xA003) register for details
  motorcomm,tx-delay-sel-fe:
    type: int
    description: |
      RGMII TX_CLK delay train configuration for 10/100 Mbit/s, about
      150ps per step (tx_delay_sel_fe, bits [7:4] of RGMII_Config1,
      EXT_0xA003). Left at its reset value when absent.
  motorcomm,rxc-delay-enable:
    type: boolean
    description: |
      Enable the fixed ~2 ns RX_CLK delay (rxc_dly_en, bit 8 of
      Chip_Config, EXT_0xA001). When absent the delay is disabled.
  motorcomm,phy-addr-scan:
    type: boolean
    description: |
      If the PHY does not answer at the address given in reg, scan the
      MDIO bus (addresses 0..31) for a YT8521/YT8531 and use the first one
      found, like ESP-IDF's PHY address auto-detection.
  default-speeds:
    default: ["10BASE Half-Duplex", "10BASE Full-Duplex", "100BASE Half-Duplex",
              "100BASE Full-Duplex", "1000BASE Half-Duplex", "1000BASE Full-Duplex"]
```

## soc/espressif/esp32s31/Kconfig
```kconfig
# Copyright (c) 2026 Espressif Systems (Shanghai) Co., Ltd.
# SPDX-License-Identifier: Apache-2.0

config SOC_SERIES_ESP32S31
	select RISCV
	select RISCV_SOC_HAS_GP_RELATIVE_ADDRESSING
	select DYNAMIC_INTERRUPTS if SOC_ESP32S31_HPCORE
	select CLOCK_CONTROL if SOC_ESP32S31_HPCORE
	select PINCTRL if SOC_ESP32S31_HPCORE
	select HAS_ESPRESSIF_HAL
	select CPU_HAS_DCACHE if SOC_ESP32S31_HPCORE
	select HAS_PM if !SMP && MP_MAX_NUM_CPUS = 1
	select HAS_POWEROFF if SMP || MP_MAX_NUM_CPUS = 1
	select SOC_HAS_TIMING_FUNCTIONS if SOC_ESP32S31_HPCORE
	select SOC_PER_CORE_INIT_HOOK if SMP || MP_MAX_NUM_CPUS > 1
	select EXPERIMENTAL if SMP

if SOC_SERIES_ESP32S31

config MAC_BB_PD
	bool "Power down MAC and baseband of Wi-Fi and Bluetooth when PHY is disabled"
	depends on SOC_SERIES_ESP32S31 && TICKLESS_KERNEL && PM
	help
	  If enabled, the MAC and baseband of Wi-Fi and Bluetooth will be powered
	  down when PHY is disabled. Enabling this setting reduces power consumption
	  by a small amount but increases RAM use by approximately 4 KB(Wi-Fi only),
	  2 KB(Bluetooth only) or 5.3 KB(Wi-Fi + Bluetooth).

rsource "Kconfig.caps"

config ESP32S31_EMAC
	bool
	default y if ETH_ESP32
	default y if MDIO_ESP32
	help
	  Hidden option to build the ESP32-S31 Ethernet MAC HAL. Both the
	  Ethernet and the MDIO driver depend on it, so MDIO can be enabled
	  independently of Ethernet.

config SOC_ESP32S31_REV_MIN_FULL
	int
	default 0 if SOC_ESP32S31_REV_0_0
	default 0
	help
	  Minimum supported ESP32-S31 chip revision in major * 100 + minor
	  format, matching what efuse_hal_chip_revision() returns at runtime.
	  Derived from the SOC_ESP32S31_REV_* symbol the board selects;
	  defaults to v0.0 (0), the floor of the family.

endif # SOC_SERIES_ESP32S31
```
